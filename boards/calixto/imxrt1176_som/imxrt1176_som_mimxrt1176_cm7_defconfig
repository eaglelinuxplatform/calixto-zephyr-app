## boards/calixto/imxrt1176_som/imxrt1176_som_mimxrt1176_cm7_defconfig
```kconfig
#
# Copyright 2026, Calixto Systems Pvt Ltd.
#
# SPDX-License-Identifier: Apache-2.0
#

CONFIG_ARM_MPU=y
CONFIG_HW_STACK_PROTECTION=y
CONFIG_PINCTRL=y
CONFIG_CONSOLE=y
CONFIG_SERIAL=y
CONFIG_GPIO=y
CONFIG_UART_CONSOLE=y
```

## lib/iol-master/Kconfig
```kconfig
menu "IO-Link Master Stack"

config IOL_MASTER
    bool "IO-Link Master stack support"
    depends on CCE4511_IOL_PL
    help
      Enables the IO-Link Master middleware
      with CCE4511 PHY IC.

if IOL_MASTER

config IOL_MASTER_NUM_CHANNELS
    int "Number of IO-Link channels"
    default 4
    range 1 4

config IOL_MASTER_STACK_SIZE
    int "IO-Link task stack size (bytes)"
    default 2048

config IOL_MASTER_TASK_PRIORITY
    int "IO-Link Master thread task priority"
    default 4

config IOL_DL_STACK_SIZE
    int "IO-Link DL task stack size (bytes)"
    default 1024

config IOL_DL_TASK_PRIORITY
    int "IO-Link DL thread task priority"
    default 5

module = IOL_MASTER
module-str = IO-Link Master
source "subsys/logging/Kconfig.template.log_config"

endif

endmenu
```

## west.yml
```yaml
manifest:
  remotes:
    - name: zephyrproject-rtos
      url-base: https://github.com/zephyrproject-rtos

  projects:
    - name: zephyr
      remote: zephyrproject-rtos
      revision: v3.7.2
      import:
        name-allowlist:
          - cmsis
          - cmsis_6
          - hal_nxp
          - mcuboot
          - tinycrypt
          - mbedtls
          - zcbor
          - littlefs
          - canopennode
          - open-amp
          - libmetal
          - fatfs
          - lvgl
```
